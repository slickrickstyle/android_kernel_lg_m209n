/* Copyright (c) 2012, Code Aurora Forum. All rights reserved.
 *
 * This program is free software; you can redistribute it and/or modify
 * it under the terms of the GNU General Public License version 2 and
 * only version 2 as published by the Free Software Foundation.
 *
 * This program is distributed in the hope that it will be useful,
 * but WITHOUT ANY WARRANTY; without even the implied warranty of
 * MERCHANTABILITY or FITNESS FOR A PARTICULAR PURPOSE.  See the
 * GNU General Public License for more details.
 */

&soc {
    i2c@78b6000 { /* BLSP1 QUP2 */
        qcom,clk-freq-out = <400000>;
        bcm2079x@76 {
            compatible = "bcm,bcm2079x";
            status = "ok";
            reg = <0x76>;
            bcm,gpio_irq = <&msm_gpio 21 0x00>;
            bcm,gpio_ven = <&msm_gpio 20 0x00>;
            bcm,gpio_mode = <&msm_gpio 110 0x00>;
            qcom,clk-src = "BBCLK2";
            interrupt-parent = <&msm_gpio>;
            interrupts = <21 0x2>;
            bcm,i2c-pull-up = <1>;
        };
    };
};