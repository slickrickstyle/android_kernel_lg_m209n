&mdss_mdp {
dsi_lgd_db7400_hd_lh530wx2_incell_vid: qcom,mdss_dsi_lgd_incell_db7400_hd_lh530wx2_video {
		compatible = "qcom,mdss-dsi-panel";
		status = "ok";
		qcom,cont-splash-enabled;
		qcom,mdss-dsi-panel-name = "LGD DB7400 HD LH530WX2";
		qcom,mdss-dsi-panel-controller = <&mdss_dsi0>;
		qcom,mdss-dsi-panel-type = "dsi_video_mode";
		qcom,mdss-dsi-panel-destination = "display_1";
		qcom,mdss-dsi-panel-framerate = <60>;
		qcom,mdss-pan-physical-width-dimension = < 66 >;
		qcom,mdss-pan-physical-height-dimension = < 117 >;
		qcom,mdss-dsi-virtual-channel-id = <0>;
		qcom,mdss-dsi-stream = <0>;
		qcom,mdss-dsi-panel-width = <720>;
		qcom,mdss-dsi-panel-height = <1280>;
		qcom,mdss-dsi-h-front-porch = <24>;
		qcom,mdss-dsi-h-back-porch = <72>;
		qcom,mdss-dsi-h-pulse-width = <4>;
		qcom,mdss-dsi-h-sync-skew = <0>;
		qcom,mdss-dsi-v-front-porch = <398>;
		qcom,mdss-dsi-v-back-porch = <11>;
		qcom,mdss-dsi-v-pulse-width = <1>;
		qcom,mdss-dsi-h-left-border = <0>;
		qcom,mdss-dsi-h-right-border = <0>;
		qcom,mdss-dsi-v-top-border = <0>;
		qcom,mdss-dsi-v-bottom-border = <0>;
		qcom,mdss-dsi-panel-timings = [8B 28 1C 00 44 40 22 26 39 03 04 00];
		qcom,mdss-dsi-t-clk-post = <0x04>;
		qcom,mdss-dsi-t-clk-pre = <0x20>;
		qcom,mdss-dsi-bpp = <24>;
		qcom,mdss-dsi-color-order = "rgb_swap_rgb";
		qcom,mdss-dsi-underflow-color = <0>;
		qcom,mdss-dsi-border-color = <0>;
		qcom,mdss-dsi-on-command = [
			15 01 00 00 00 00 02 /*Set Address Mode*/
			36 00

			15 01 00 00 00 00 02 /*Manufacturer Command Access Protect*/
			B0 00

			29 01 00 00 00 00 03 /*RGB Interface Set*/
			B1 00 2A

			29 01 00 00 00 00 07 /*Module Characteristics Set*/
			B2 50 00 0B 00 00 00

			29 01 00 00 00 00 05 /*Internal Timing Set*/
			B3 4F 80 0A 28

			29 01 00 00 00 00 07 /*Channel Control*/
			B4 05 04 1F 18 11 00

			29 01 00 00 00 00 34 /*GIP Control Set*/
			B5 19 04 1C 22 2F 80
			2F 1F 02 20 05 00 10
			08 02 20 05 00 95 0C
			2F 2F 3F FF 3F FF 01
			7C 00 02 50 23 40 15
			6C CB BA A9 97 8D 1F
			23 40 15 6C CB BA A9
			97 8D 1F

			29 01 00 00 00 00 03 /*Touch Enable*/
			B6 01 01

			29 01 00 00 00 00 04 /*GVDDP Control */
			B7 00 4B 4B

			29 01 00 00 00 00 10 /*VGHL Control*/
			BB 00 90 90 30 30 00
			00 00 00 00 00 00 00
			00 13

			29 01 00 00 00 00 03 /*Bias Control*/
			BD 03 33

			29 01 00 00 00 00 02 /*VCI1 Control*/
			BE 03

			29 01 00 00 00 00 07 /*Write DSI Control*/
			95 00 05 10 00 00 00

			29 01 00 00 00 00 02 /*Touch Control Set*/
			CF 03

			29 01 00 00 00 00 03 /*Mipi Parameter Setting*/
			C6 0E 00

			29 01 00 00 00 00 1B /*Touch GIP Control*/
			D7 00 13 FF 39 0B 04
			14 F4 01 00 00 00 00
			60 01 57 57 41 28 28
			3F 00 00 00 00 00

			29 01 00 00 00 00 06 /*Touch LFD Control Set*/
			F5 00 06 00 00 80

			29 01 00 00 00 00 02 /*VDD1 Set*/
			F6 06

			29 01 00 00 00 00 24 /*Power Sequence Control*/
			F0 18 00 14 14 00 0B
			0B 16 0B 19 41 16 17
			69 6E 73 78 BC C1 C6
			B0 B0 AF B0 AD 85 B0
			B0 5D 58 53 4E 0A 05
			00

			/* Gamma setting */
			29 01 00 00 00 00 0A
			D0 53 35 66 63 01 02
			70 75 04

			29 01 00 00 00 00 05
			D0 53 35 66 63

			29 01 00 00 00 00 0A
			D1 63 35 66 63 01 02
			70 75 04

			29 01 00 00 00 00 05
			D1 63 35 66 63

			29 01 00 00 00 00 0A
			D2 53 35 66 63 01 02
			70 75 04

			29 01 00 00 00 00 05
			D2 53 35 66 63

			29 01 00 00 00 00 0A
			D3 63 35 66 63 01 02
			70 75 04

			29 01 00 00 00 00 05
			D3 63 35 66 63

			29 01 00 00 00 00 0A
			D4 53 35 66 72 01 02
			70 75 04

			29 01 00 00 00 00 05
			D4 53 35 66 72

			29 01 00 00 00 00 0A
			D5 63 35 66 72 01 02
			70 75 04

			29 01 00 00 00 00 05
			D5 63 35 66 72

			/* Color Enhancement */
			29 01 00 00 00 00 1A
			85 11 6E 22 5A 19 44
			28 7F 4D AD 85 62 A2
			9B 8C 65 51 97 60 B0
			9C 65 51 A5 62

			05 01 00 00 78 00 01 /*exit sleep 120msec*/
			11

			05 01 00 00 00 00 01 /*display on*/
			29
			];

		qcom,mdss-dsi-off-command = [
			05 01 00 00 19 00 01 /*Display Off*/
			28
			05 01 00 00 37 00 01 /*Sleep In*/
			10
		];

		qcom,mdss-dsi-on-command-state = "dsi_lp_mode";
		qcom,mdss-dsi-off-command-state = "dsi_hs_mode";
		qcom,mdss-dsi-traffic-mode = "non_burst_sync_pulse";
		qcom,mdss-dsi-tx-eot-append;
		qcom,mdss-dsi-h-sync-pulse = <1>;
		qcom,mdss-dsi-lane-map = "lane_map_0123";
		qcom,mdss-dsi-bllp-eof-power-mode;
		//qcom,mdss-dsi-bllp-power-mode;
		qcom,mdss-dsi-last-line-interleave;
		qcom,mdss-dsi-lane-0-state;
		qcom,mdss-dsi-lane-1-state;
		qcom,mdss-dsi-lane-2-state;
		qcom,mdss-dsi-lane-3-state;
		qcom,mdss-dsi-lp11-init;
		qcom,mdss-dsi-cont_clk_enabled;
		qcom,mdss-dsi-dma-trigger = "trigger_sw";
		qcom,mdss-dsi-mdp-trigger = "none";
		qcom,mdss-dsi-reset-sequence = <1 1>, <0 5>, <1 30>;
		qcom,mdss-dsi-bl-pmic-control-type = "bl_others";
		qcom,mdss-dsi-bl-min-level = <1>;
		qcom,mdss-dsi-bl-max-level = <255>;
	};
};
