&dsi_lgd_lg4894_hd_video {
	qcom,mdss-dsi-on-command-rev1 = [
		15 01 00 00 00 00 02 B0 AC
		39 01 00 00 00 00 05 B1 10 30 16 00
		39 01 00 00 00 00 0D B2 01 00 21 20 58 00 CF 10 1F 1F 34 34
		39 01 00 00 00 00 04 B4 00 9F 00
		39 01 00 00 00 00 06 B5 42 C0 80 00 00
		39 01 00 00 00 00 04 B6 77 34 48
		39 01 00 00 00 00 0A BD D0 02 F4 01 04 04 12 20 22
		39 01 00 00 00 00 08 BE E0 E0 C9 C9 C8 F8 00
		39 01 00 00 00 00 07 C1 01 E8 D8 C2 C1 00
		39 01 00 00 00 00 04 C2 3B 13 13
		39 01 00 00 00 00 07 C3 15 2F 2F 00 A6 21
		39 01 00 00 00 00 04 C4 51 00 37
		39 01 00 00 00 00 06 C5 25 20 20 14 14
		39 01 00 00 00 00 0D C7 10 22 00 28 00 62 62 62 00 B1 01 00
		39 01 00 00 00 00 05 C8 01 55 03 0C
		39 01 00 00 00 00 0F CC 22 2F 11 26 21 24 02 62 62 62 00 B1 01 00
		39 01 00 00 00 00 0D D0 10 67 43 43 32 51 00 00 00 42 46 03
		39 01 00 00 00 00 0D D1 10 67 43 43 32 51 00 00 00 42 46 03
		39 01 00 00 00 00 0D D2 10 67 43 43 32 51 00 00 00 42 46 03
		39 01 00 00 00 00 0D D3 10 67 43 43 32 51 00 00 00 42 46 03
		39 01 00 00 00 00 0D D4 10 67 43 43 32 70 0F 0F 00 21 46 03
		39 01 00 00 00 00 0D D5 10 67 43 43 32 70 0F 0F 00 21 46 03
		39 01 00 00 00 00 16 E4 2F C3 2F 60 41 C5 C6 CC CC CB 2F CB CA CA C9 C9 C7 C8 2F 41 2F
		39 01 00 00 00 00 0D E5 FF FF FF FF FF 13 EF FF FF FF FF 03
		05 01 00 00 55 00 01 11
		05 01 00 00 00 00 01 29
	];
};
