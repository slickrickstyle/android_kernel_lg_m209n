&i2c_6 {
	sm5306@38 {
		compatible = "backlight,sm5306";
		status = "ok";
		reg = <0x38>;
		sm5306,max_current = <0x18>;
		sm5306,lcd_bl_en = <&msm_gpio 24 0>;
		sm5306,min_brightness = <0x04>;
		sm5306,default_brightness = <0xA8>;
		sm5306,max_brightness = <0xFF>;
		sm5306,enable_pwm = <0>;
		sm5306,blmap_size = <256>;
		sm5306,blmap = <
			3 3 3 3 3 3 3 3 3 3 4 4 4 4 4 4
			4 4 4 4 4 4 4 4 4 5 5 5 5 5 5 5
			5 5 6 6 6 6 6 6 6 7 7 7 7 7 8 8
			8 8 9 9 9 9 10 10 10 11 11 11 11 11 12 12
			13 13 14 14 14 15 15 15 16 16 17 17 18 18 18 19
			19 20 20 21 21 22 22 23 23 24 24 25 26 26 27 27
			28 28 29 30 31 32 32 33 34 34 35 36 36 36 36 38
			39 40 41 41 42 43 44 44 45 46 47 47 48 49 50 50
			51 52 53 53 54 55 56 57 58 59 60 61 61 62 62 63
			63 64 65 66 67 68 69 70 71 72 74 75 76 77 77 77
			81 82 85 85 85 87 88 89 90 92 93 94 96 97 98 100
			101 102 104 105 106 108 109 110 112 113 115 116 118 119 121 122
			124 126 127 129 130 132 133 135 137 138 140 142 143 145 147 147
			147 152 154 155 157 159 161 163 165 166 168 170 172 174 176 178
			180 182 184 186 188 190 191 194 196 198 200 202 204 206 208 211
			213 215 217 220 222 224 226 229 231 233 236 238 241 244 247 249>;
	};
};
