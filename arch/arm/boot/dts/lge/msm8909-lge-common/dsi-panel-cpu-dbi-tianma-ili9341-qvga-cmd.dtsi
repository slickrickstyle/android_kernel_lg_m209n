/* Copyright (c) 2013, The Linux Foundation. All rights reserved.
 *
 * This program is free software; you can redistribute it and/or modify
 * it under the terms of the GNU General Public License version 2 and
 * only version 2 as published by the Free Software Foundation.
 *
 * This program is distributed in the hope that it will be useful,
 * but WITHOUT ANY WARRANTY; without even the implied warranty of
 * MERCHANTABILITY or FITNESS FOR A PARTICULAR PURPOSE.  See the
 * GNU General Public License for more details.
 */

/*---------------------------------------------------------------------------
 * This file is autogenerated file using gcdb parser. Please do not edit it.
 * Update input XML file to add a new entry or update variable in this file
 * VERSION = "1.0"
 *---------------------------------------------------------------------------*/
&mdss_mdp {
	dsi_cpu_dbi_tianma_ili9341_qvga_cmd: qcom,mdss_dsi_cpu_dbi_tianma_ili9341_qvga_cmd {
		qcom,mdss-dsi-panel-name = "ili9341 cling qvga command mode panel";
		qcom,mdss-dsi-panel-controller = <&mdss_dsi0>;
		qcom,mdss-dsi-panel-type = "dsi_video_mode";
		qcom,mdss-dsi-panel-destination = "display_1";
		qcom,mdss-dsi-panel-orientation = "180";
		qcom,mdss-dsi-panel-framerate = <60>;
		qcom,mdss-dsi-virtual-channel-id = <0>;
		qcom,mdss-dsi-stream = <0>;
		qcom,mdss-dsi-panel-width = <240>;
		qcom,mdss-dsi-panel-height = <320>;
		qcom,mdss-dsi-h-front-porch = <7>;
		qcom,mdss-dsi-h-back-porch = <7>;
		qcom,mdss-dsi-h-pulse-width = <8>;
		qcom,mdss-dsi-h-sync-skew = <0>;
		qcom,mdss-dsi-v-back-porch = <7>;
		qcom,mdss-dsi-v-front-porch = <7>;
		qcom,mdss-dsi-v-pulse-width = <1>;
		qcom,mdss-dsi-h-left-border = <0>;
		qcom,mdss-dsi-h-right-border = <0>;
		qcom,mdss-dsi-v-top-border = <0>;
		qcom,mdss-dsi-v-bottom-border = <0>;
		qcom,mdss-dsi-bpp = <16>;
		qcom,mdss-dsi-color-order = "rgb_swap_rgb";
		qcom,mdss-dsi-underflow-color = <0xff>;
		qcom,mdss-dsi-border-color = <0>;
		qcom,mdss-dsi-on-command = [29 01 00 00 00 00 04 CF 00 D1 30
		29 01 00 00 00 00 04 F6 01 30 00
		29 01 00 00 00 00 03 B1 00 19
		29 01 00 00 00 00 05 ED 64 03 12 81
		29 01 00 00 00 00 04 E8 85 00 78
		29 01 00 00 00 00 06 CB 39 2C 00 34 02
		15 01 00 00 00 00 02 F7 20
		29 01 00 00 00 00 03 EA 66 00
		15 01 00 00 00 00 02 C0 2B
		15 01 00 00 00 00 02 C1 01
		29 01 00 00 00 00 03 C5 5C 4C
		15 01 00 00 00 00 02 C7 A5
		15 01 00 00 00 00 02 36 48
		15 01 00 00 00 00 02 3A 65
		15 01 00 00 00 00 02 F2 00
		15 01 00 00 00 00 02 26 01
		29 01 00 00 00 00 10 E0 0F 2F 1D 0A 10 0A 4D B9 39 09 10 03 02 0B 08
		29 01 00 00 00 00 10 E1 0F 10 22 05 0F 05 32 46 46 06 0F 0C 3D 34 07
		05 01 00 00 64 00 02 11 00
		05 01 00 00 78 00 02 29 00
		29 01 00 00 00 00 05 2A 00 00 00 EF
		29 01 00 00 00 00 05 2B 00 00 00 3F
		05 01 00 00 0A 00 02 2C 00];
		qcom,mdss-dsi-off-command = [05 01 00 00 32 00 02 28 00
		05 01 00 00 78 00 02 10 00];
		qcom,mdss-dsi-on-command-state = "dsi_lp_mode";
		qcom,mdss-dsi-off-command-state = "dsi_hs_mode";
		qcom,mdss-dsi-h-sync-pulse = <0>;
		qcom,mdss-dsi-traffic-mode = "non_burst_sync_event";
		qcom,mdss-dsi-lane-map = "lane_map_0123";
		qcom,mdss-dsi-bllp-eof-power-mode;
		qcom,mdss-dsi-bllp-power-mode;
		qcom,mdss-dsi-lane-0-state;
		qcom,mdss-dsi-te-pin-select = <1>;
		qcom,mdss-dsi-te-v-sync-rd-ptr-irq-line = <0x2c>;
		qcom,mdss-dsi-te-dcs-command = <1>;
		qcom,mdss-dsi-te-check-enable;
		qcom,mdss-dsi-te-using-te-pin;
		qcom,mdss-dsi-panel-timings = [30 0A 02 00 20 2C 08 0C 06 03 04 00];
		qcom,mdss-dsi-t-clk-post = <0x05>;
		qcom,mdss-dsi-t-clk-pre = <0x14>;
		qcom,mdss-dsi-bl-min-level = <1>;
		qcom,mdss-dsi-bl-max-level = <32>;
		qcom,mdss-dsi-dma-trigger = "trigger_sw";
		qcom,mdss-dsi-mdp-trigger = "none";
		qcom,mdss-dsi-bl-pmic-control-type = "bl_others";
		qcom,mdss-pan-physical-width-dimension = <34>;
		qcom,mdss-pan-physical-height-dimension = <45>;
		qcom,mdss-dsi-reset-sequence = <1 5>, <0 5>, <1 120>;
	};
};
