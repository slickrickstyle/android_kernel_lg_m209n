&mdss_mdp {
dsi_lgd_db7400_hd_5inch_incell_vid: qcom,mdss_dsi_lgd_incell_db7400_hd_5inch_video {
								  compatible = "qcom,mdss-dsi-panel";
								  status = "ok";
								  qcom,cont-splash-enabled;
								  qcom,mdss-dsi-panel-name = "LGD DB7400 HD 5Inch video mode";
								  qcom,mdss-dsi-panel-controller = <&mdss_dsi0>;
								  qcom,mdss-dsi-panel-type = "dsi_video_mode";
								  qcom,mdss-dsi-panel-destination = "display_1";
								  qcom,mdss-dsi-panel-framerate = <60>;
								  qcom,mdss-pan-physical-width-dimension = < 62 >;
								  qcom,mdss-pan-physical-height-dimension = < 110 >;
								  qcom,mdss-dsi-virtual-channel-id = <0>;
								  qcom,mdss-dsi-stream = <0>;
								  qcom,mdss-dsi-panel-width = <720>;
								  qcom,mdss-dsi-panel-height = <1280>;
								  qcom,mdss-dsi-h-front-porch = <24>;
								  qcom,mdss-dsi-h-back-porch = <72>;
								  qcom,mdss-dsi-h-pulse-width = <4>;
								  qcom,mdss-dsi-h-sync-skew = <0>;
								  qcom,mdss-dsi-v-front-porch = <398>;
								  qcom,mdss-dsi-v-back-porch = <11>;
								  qcom,mdss-dsi-v-pulse-width = <1>;
								  qcom,mdss-dsi-h-left-border = <0>;
								  qcom,mdss-dsi-h-right-border = <0>;
								  qcom,mdss-dsi-v-top-border = <0>;
								  qcom,mdss-dsi-v-bottom-border = <0>;
								  qcom,mdss-dsi-panel-timings = [8B 28 1C 00 44 44 1E 2A 39 03 04 00];
								  qcom,mdss-dsi-t-clk-post = <0x04>;
								  qcom,mdss-dsi-t-clk-pre = <0x20>;
								  qcom,mdss-dsi-bpp = <24>;
								  qcom,mdss-dsi-color-order = "rgb_swap_rgb";
								  qcom,mdss-dsi-underflow-color = <0>;
								  qcom,mdss-dsi-border-color = <0>;
								  qcom,mdss-dsi-on-command = [
									  15 01 00 00 00 00 02 /*address*/
									  36 00

									  15 01 00 00 00 00 02 /*manufacturer*/
									  B0 00

									  29 01 00 00 00 00 03 /*RGB interface*/
									  B1 00 2A

									  29 01 00 00 00 00 07 /*module charateristic set*/
									  B2 50 00 0B 00 00 00

									  29 01 00 00 00 00 05 /*internal timgin set*/
									  B3 4F 80 0A 28

									  29 01 00 00 00 00 07/*channel control*/
									  B4 05 04 1F 18 11 00

									  29 01 00 00 00 00 34 /*GIP Control Set*/
									  B5 19 04 1C 21 2F 80
									  2F 1F 02 20 05 00 10
									  08 02 20 05 00 95 0C
									  2F 2F 3F FF 3F FF 01
									  7C 00 02 50 23 40 15
									  6C CB BA A9 97 8D 1F
									  23 40 15 6C CB BA A9
									  97 8D 1F

									  29 01 00 00 00 00 03 /*touch enable*/
									  B6 01 01

									  29 01 00 00 00 00 04 /*gvddp*/
									  B7 00 5A 5A

									  29 01 00 00 00 00 10 /*vghl*/
									  BB 00 96 8E 30 30 00
									  00 00 00 00 00 00 00
									  00 13

									  29 01 00 00 00 00 03 /*SAP*/
									  BD 03 33

									  15 01 00 00 00 00 02 /*vci1*/
									  BE 03

									  29 01 00 00 00 00 07 /*write dsi control*/
									  95 00 05 10 00 00 00

  									  29 01 00 00 00 00 02 /*touch control set*/
									  CF 03

									  29 01 00 00 00 00 03 /*mipi parameter setting*/
									  C6 0E 00

									  29 01 00 00 00 00 1B /*touch gip control*/
									  D7 00 13 FF 39 0B 04
									  14 F4 01 00 00 00 00
									  60 01 57 57 2F 28 28
									  55 00 00 00 00 00

									  29 01 00 00 00 00 06 /*DB check need*/
									  F5 00 06 00 00 80

									  29 01 00 00 00 00 24/*power sequence control*/
									  F0 18 00 14 14 00 00
									  00 01 00 03 2B 01 02
									  53 58 5D 62 A6 AB B0
									  B0 B0 AF B0 AD 85 B0
									  B0 5D 58 53 4E 0A 05
									  00

									  29 01 00 00 00 00 0A /*pos gamma curve red*/
									  D0 32 34 75 13 02 02
									  50 65 02
									  
									  29 01 00 00 00 00 0A /*neg gamma curve red*/
									  D1 32 34 75 13 00 02
									  50 65 02
									  									  
									  29 01 00 00 00 00 0A /*pos gamma curve green*/
									  D2 32 34 75 13 02 02
									  50 65 02
									  
									  29 01 00 00 00 00 0A /*neg gamma curve green*/
									  D3 32 34 75 13 00 02
									  50 65 02
									  
									  29 01 00 00 00 00 0A /*pos gamma curve blue*/
									  D4 32 34 75 23 02 02
									  50 65 02
									  
									  29 01 00 00 00 00 0A /*neg gamma curve blue*/
									  D5 32 34 75 23 00 02
									  50 65 02

									  29 01 00 00 00 00 05 /*pos gamma curve red*/
									  D0 32 34 75 13

									  29 01 00 00 00 00 05 /*neg gamma curve green*/
									  D1 32 34 75 13

									  29 01 00 00 00 00 05 /*pos gamma curve blue*/
									  D2 32 34 75 13

									  29 01 00 00 00 00 05 /*neg gamma curve red*/
									  D3 32 34 75 13

									  29 01 00 00 00 00 05 /*pos gamma curve green*/
									  D4 32 34 75 23

									  29 01 00 00 00 00 05 /*neg gamma curve blue*/
									  D5 32 34 75 23

									  29 01 00 00 0A 00 1A /*CE*/
									  85 11 6E 22 5A 19 44
									  28 7F 4D AD 85 62 A2
									  9B 8C 65 51 97 60 B0
									  9C 65 51 A5 62

									  05 01 00 00 78 00 01 /*exit sleep*/
									  11

									  05 01 00 00 00 00 01 /*display on*/
									  29
									  ];
  qcom,mdss-dsi-on-command_p4 = [
	  15 01 00 00 00 00 02 /*address*/
	  36 00

	  15 01 00 00 00 00 02 /*manufacturer*/
	  B0 00

	  29 01 00 00 00 00 03 /*RGB interface*/
	  B1 00 2A

	  29 01 00 00 00 00 07 /*module charateristic set*/
	  B2 50 00 0B 00 00 00

	  29 01 00 00 00 00 05 /*internal timgin set*/
	  B3 4F 80 0A 27

	  29 01 00 00 00 00 07/*channel control*/
	  B4 05 03 1F 18 11 00

	  29 01 00 00 00 00 34 /*GIP Control Set*/
	  B5 19 04 1C 21 2F 80
	  2F 1F 02 20 05 00 10
	  08 02 20 05 00 95 0C
	  2F 2F 3F FF 3F FF 01
	  7C 00 02 50 23 40 15
	  6C CB BA A9 97 8D 1F
	  23 40 15 6C CB BA A9
	  97 8D 1F

	  29 01 00 00 00 00 03 /*touch enable*/
	  B6 01 01

	  29 01 00 00 00 00 04 /*gvddp*/
	  B7 00 5A 5A

	  29 01 00 00 00 00 10 /*vghl*/
	  BB 00 56 0E 00 00 00
	  00 00 00 00 00 00 00
	  00 11

	  29 01 00 00 00 00 03 /*SAP*/
	  BD 02 31

	  15 01 00 00 00 00 02 /*vci1*/
	  BE 03

	  29 01 00 00 00 00 07 /*write dsi control*/
	  95 00 05 10 00 00 00

	  29 01 00 00 00 00 02 /*touch control set*/
	  CF 03

	  29 01 00 00 00 00 03 /*mipi parameter setting*/
	  C6 0E 00

	  29 01 00 00 00 00 1B /*touch gip control*/
	  D7 00 13 FF 39 0B 04
	  14 F4 01 00 00 00 00
	  60 01 57 57 2F 28 28
	  55 00 00 00 00 00

	  29 01 00 00 00 00 06 /*DB check need*/
	  F5 00 06 00 00 80

	  29 01 00 00 00 00 24/*power sequence control*/
	  F0 18 00 14 14 00 00
	  00 01 00 03 2B 01 02
	  53 58 5D 62 A6 AB B0
	  B0 B0 AF B0 AD 85 B0
	  B0 5D 58 53 4E 0A 05
	  00

	  29 01 00 00 00 00 0A /*pos gamma curve red*/
	  D0 22 43 57 73 02 01
	  50 13 02

	  29 01 00 00 00 00 0A /*neg gamma curve red*/
	  D1 22 43 57 73 02 01
	  50 13 02

	  29 01 00 00 00 00 0A /*pos gamma curve green*/
	  D2 22 43 57 73 03 01
	  50 13 02

	  29 01 00 00 00 00 0A /*neg gamma curve green*/
	  D3 22 43 57 73 03 01
	  50 13 02

	  29 01 00 00 00 00 0A /*pos gamma curve blue*/
	  D4 22 43 57 73 00 01
	  50 13 02

	  29 01 00 00 00 00 0A /*neg gamma curve blue*/
	  D5 22 43 57 73 00 01
	  50 13 02

	  29 01 00 00 00 00 05 /*pos gamma curve red*/
	  D0 22 43 57 73

	  29 01 00 00 00 00 05 /*neg gamma curve green*/
	  D1 22 23 57 73

	  29 01 00 00 00 00 05 /*pos gamma curve blue*/
	  D2 22 43 57 73

	  29 01 00 00 00 00 05 /*neg gamma curve red*/
	  D3 22 43 57 73

	  29 01 00 00 00 00 05 /*pos gamma curve green*/
	  D4 22 43 57 73

	  29 01 00 00 00 00 05 /*neg gamma curve blue*/
	  D5 22 43 57 73

	  29 01 00 00 0A 00 1A /*CE*/
	  85 11 6E 22 5A 19 44
	  28 7F 4D AD 85 62 A2
	  9B 8C 65 51 97 60 B0
	  9C 65 51 A5 62

	  05 01 00 00 78 00 01 /*exit sleep*/
	  11

	  05 01 00 00 00 00 01 /*display on*/
	  29
	  ];

								  qcom,mdss-dsi-off-command = [
									  05 01 00 00 14 00 01
									  28
									  05 01 00 00 28 00 01
									  10

									  ];

								  qcom,mdss-dsi-on-command-state = "dsi_lp_mode";
								  qcom,mdss-dsi-off-command-state = "dsi_hs_mode";
								  qcom,mdss-dsi-lut-update-command-state = "dsi_hs_mode";
								  qcom,mdss-dsi-h-sync-pulse = <0>;
								  qcom,mdss-dsi-traffic-mode = "non_burst_sync_pulse";
								  qcom,mdss-dsi-tx-eot-append;
								  qcom,mdss-dsi-lane-map = "lane_map_0123";
								  qcom,mdss-dsi-bllp-eof-power-mode;
								  //qcom,mdss-dsi-bllp-power-mode;
								  qcom,mdss-dsi-last-line-interleave;
								  qcom,mdss-dsi-lane-0-state;
								  qcom,mdss-dsi-lane-1-state;
								  qcom,mdss-dsi-lane-2-state;
								  qcom,mdss-dsi-lane-3-state;
								  qcom,mdss-dsi-lp11-init;
								  qcom,mdss-dsi-dma-trigger = "trigger_sw";
								  qcom,mdss-dsi-mdp-trigger = "none";
								  qcom,mdss-dsi-reset-sequence = <1 1>, <0 5>, <1 30>;
								  qcom,mdss-dsi-bl-pmic-control-type = "bl_others";
								  qcom,mdss-dsi-bl-min-level = <1>;
								  qcom,mdss-dsi-bl-max-level = <255>;
							  };
};
