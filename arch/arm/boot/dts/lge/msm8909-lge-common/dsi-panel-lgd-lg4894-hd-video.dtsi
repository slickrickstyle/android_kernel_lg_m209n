/* Copyright (c) 2013, The Linux Foundation. All rights reserved.
 *
 * This program is free software; you can redistribute it and/or modify
 * it under the terms of the GNU General Public License version 2 and
 * only version 2 as published by the Free Software Foundation.
 *
 * This program is distributed in the hope that it will be useful,
 * but WITHOUT ANY WARRANTY; without even the implied warranty of
 * MERCHANTABILITY or FITNESS FOR A PARTICULAR PURPOSE.  See the
 * GNU General Public License for more details.
 */

/*---------------------------------------------------------------------------
 * This file is autogenerated file using gcdb parser. Please do not edit it.
 * Update input XML file to add a new entry or update variable in this file
 * VERSION = "1.0"
 *---------------------------------------------------------------------------*/
&mdss_mdp {
	dsi_lgd_lg4894_hd_video: qcom,mdss_dsi_lgd_lg4894_hd_video {
		compatible = "qcom,mdss-dsi-panel";
		status = "ok";
		qcom,cont-splash-enabled;
		qcom,mdss-dsi-panel-name = "LGD LG4894 HD video mode dsi panel";
		qcom,mdss-dsi-panel-controller = <&mdss_dsi0>;
		qcom,mdss-dsi-panel-type = "dsi_video_mode";
		qcom,mdss-dsi-panel-destination = "display_1";
		qcom,mdss-dsi-force-clock-lane-hs;
		qcom,mdss-dsi-panel-framerate = <60>;
		qcom,mdss-dsi-virtual-channel-id = <0>;
		qcom,mdss-dsi-stream = <0>;
		qcom,mdss-dsi-lp11-init;
		qcom,suspend-ulps-enabled;
		qcom,esd-check-enabled;
		qcom,mdss-dsi-panel-status-check-mode = "reg_read";
		qcom,mdss-dsi-tx-eot-append;
		qcom,mdss-dsi-panel-width = <720>;
		qcom,mdss-dsi-panel-height = <1280>;
		qcom,mdss-dsi-h-front-porch = <12>;
		qcom,mdss-dsi-h-back-porch = <36>;
		qcom,mdss-dsi-h-pulse-width = <4>;
		qcom,mdss-dsi-h-sync-skew = <0>;
		qcom,mdss-dsi-v-back-porch = <15>;
		qcom,mdss-dsi-v-front-porch = <500>;
		qcom,mdss-dsi-v-pulse-width = <1>;
		qcom,mdss-dsi-h-left-border = <0>;
		qcom,mdss-dsi-h-right-border = <0>;
		qcom,mdss-dsi-v-top-border = <0>;
		qcom,mdss-dsi-v-bottom-border = <0>;
		qcom,mdss-pan-physical-width-dimension = < 66 >; // 65.98mm
		qcom,mdss-pan-physical-height-dimension = < 117 >; // 117.31 mm
		qcom,mdss-dsi-bpp = <24>;
		qcom,mdss-dsi-color-order = "rgb_swap_rgb";
		qcom,mdss-dsi-underflow-color = <0xff>;
		qcom,mdss-dsi-border-color = <0>;
		qcom,mdss-dsi-on-command = [
			15 01 00 00 00 00 02 B0 AC
			39 01 00 00 00 00 05 B1 10 30 16 00
			39 01 00 00 00 00 0D B2 01 00 21 20 58 00 CF 10 1F 1F 34 34
			39 01 00 00 00 00 04 B4 00 9F 00
			39 01 00 00 00 00 06 B5 42 C0 80 00 00
			39 01 00 00 00 00 04 B6 77 34 48
			39 01 00 00 00 00 0A BD D0 02 F4 01 04 04 12 20 22
			39 01 00 00 00 00 08 BE E0 E0 C9 C9 C8 F8 00
			39 01 00 00 00 00 07 C1 01 E8 D8 C2 C1 00
			39 01 00 00 00 00 04 C2 3B 13 13
			39 01 00 00 00 00 07 C3 15 2F 2F 00 66 21
			39 01 00 00 00 00 04 C4 51 00 37
			39 01 00 00 00 00 06 C5 25 20 20 14 14
			39 01 00 00 00 00 0D C7 10 22 00 28 00 62 62 62 00 B1 01 00
			39 01 00 00 00 00 05 C8 01 00 03 8C
			39 01 00 00 00 00 0F CC 22 2F 11 26 21 24 02 62 62 62 00 B1 01 00
			39 01 00 00 00 00 0D D0 10 67 43 43 32 51 00 00 00 42 46 03
			39 01 00 00 00 00 0D D1 10 67 43 43 32 51 00 00 00 42 46 03
			39 01 00 00 00 00 0D D2 10 67 43 43 32 51 00 00 00 42 46 03
			39 01 00 00 00 00 0D D3 10 67 43 43 32 51 00 00 00 42 46 03
			39 01 00 00 00 00 0D D4 10 67 43 43 32 70 0F 0F 00 21 46 03
			39 01 00 00 00 00 0D D5 10 67 43 43 32 70 0F 0F 00 21 46 03
			39 01 00 00 00 00 16 E4 2F C3 2F 60 41 C5 C6 CC CC CB 2F CB CA CA C9 C9 C7 C8 2F 41 2F
			39 01 00 00 00 00 0D E5 FF FF FF FF FF 13 EF FF FF FF FF 03
			05 01 00 00 55 00 01 11
			05 01 00 00 00 00 01 29
		];
		qcom,mdss-dsi-off-command = [
			05 01 00 00 64 00 01 28
			05 01 00 00 78 00 01 10
		];
		qcom,mdss-dsi-touch-osc-on-command = [
			15 01 00 00 01 00 02 BF 20
			15 01 00 00 01 00 02 BF 60
		];
		qcom,mdss-dsi-touch-osc-off-command = [
			15 01 00 00 01 00 02 BF 20
			15 01 00 00 01 00 02 BF 00
		];
		qcom,panel-reader-mode-step1-command = [	// LOW 5850K
			39 01 00 00 00 00 11 F5 40 40 40 40 40 40 40 40 00 00 00 00 00 00 00 00
			39 01 00 00 00 00 11 F6 40 40 40 40 40 40 40 40 00 00 00 00 00 00 00 00
			39 01 00 00 00 00 11 F7 34 34 34 34 34 34 34 34 00 00 00 00 00 00 00 00
			15 01 00 00 00 00 02 ED 04
		];
		qcom,panel-reader-mode-step2-command = [	// MIDDLE 5500K
			39 01 00 00 00 00 11 F5 40 40 40 40 40 40 40 40 00 00 00 00 00 00 00 00
			39 01 00 00 00 00 11 F6 40 40 40 40 40 40 40 40 00 00 00 00 00 00 00 00
			39 01 00 00 00 00 11 F7 2F 2F 2F 2F 2F 2F 2F 2F 00 00 00 00 00 00 00 00
			15 01 00 00 00 00 02 ED 04
		];
		qcom,panel-reader-mode-step3-command = [	// HIGH 5350K
			39 01 00 00 00 00 11 F5 3F 3F 3F 3F 3F 3F 3F 3F 00 00 00 00 00 00 00 00
			39 01 00 00 00 00 11 F6 3F 3F 3F 3F 3F 3F 3F 3F 00 00 00 00 00 00 00 00
			39 01 00 00 00 00 11 F7 2D 2D 2D 2D 2D 2D 2D 2D 00 00 00 00 00 00 00 00
			15 01 00 00 00 00 02 ED 04
		];
		qcom,panel-reader-mode-off-command = [		// NORMAL
			15 01 00 00 00 00 02 ED 00
		];
		qcom,mdss-dsi-on-command-state = "dsi_lp_mode";
		qcom,mdss-dsi-off-command-state = "dsi_hs_mode";
		qcom,mdss-dsi-touch-osc-command-state = "dsi_lp_mode";
		qcom,mdss-dsi-reader-mode-command-state = "dsi_hs_mode";
		qcom,mdss-dsi-h-sync-pulse = <0>;
		qcom,mdss-dsi-traffic-mode = "non_burst_sync_event";
		qcom,mdss-dsi-lane-map = "lane_map_0123";
		qcom,mdss-dsi-bllp-eof-power-mode;
		qcom,mdss-dsi-bllp-power-mode;
		qcom,mdss-dsi-last-line-interleave;
		qcom,mdss-dsi-lane-0-state;
		qcom,mdss-dsi-lane-1-state;
		qcom,mdss-dsi-lane-2-state;
		qcom,mdss-dsi-lane-3-state;
		qcom,mdss-dsi-panel-timings = [8B 1E 14 00 44 4A 18 22 19 03 04 00];
		qcom,mdss-dsi-t-clk-post = <0x04>;
		qcom,mdss-dsi-t-clk-pre = <0x1C>;
		qcom,mdss-dsi-bl-min-level = <1>;
		qcom,mdss-dsi-bl-max-level = <255>;
		qcom,mdss-dsi-bl-pmic-control-type = "bl_others";
		qcom,mdss-dsi-dma-trigger = "trigger_sw";
		qcom,mdss-dsi-mdp-trigger = "none";
		qcom,mdss-dsi-reset-sequence = <1 0>, <0 1>, <1 0>;
		qcom,mdss-dsi-panel-status-command = [06 01 00 01 05 00 02 05 00];
		qcom,mdss-dsi-panel-status-command-state = "dsi_hs_mode";
		qcom,mdss-dsi-panel-status-value = <0x00>;
	};
};

#include "dsi-panel-lgd-lg4894-hd-video-rev0.dtsi"
#include "dsi-panel-lgd-lg4894-hd-video-rev1.dtsi"
#include "dsi-panel-lgd-lg4894-hd-video-rev2.dtsi"
