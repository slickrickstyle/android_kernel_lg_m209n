/* Copyright (c) 2012, Code Aurora Forum. All rights reserved.
 *
 * This program is free software; you can redistribute it and/or modify
 * it under the terms of the GNU General Public License version 2 and
 * only version 2 as published by the Free Software Foundation.
 *
 * This program is distributed in the hope that it will be useful,
 * but WITHOUT ANY WARRANTY; without even the implied warranty of
 * MERCHANTABILITY or FITNESS FOR A PARTICULAR PURPOSE.  See the
 * GNU General Public License for more details.
 */

&soc {
	i2c@78b9000 { /* BLSP1 QUP5 */
		qcom,clk-freq-out = <400000>;
		lge_touch@34 {
			compatible = "unified_driver4,mit300";
			status = "ok";
			reg = <0x34>;

			pinctrl-names = "default","pmx_ts_suspend";
			pinctrl-0 = <&ts_int_active &ts_reset_active>;
			pinctrl-1 = <&ts_int_suspend &ts_reset_suspend>;

			interrupt-parent = <&msm_gpio>;
			interrupts = <13 0x2>;

			vdd_dd-supply = <&pm8916_l15>;
			vdd_ana-supply = <&pm8916_l16>;
		};
	};
};

