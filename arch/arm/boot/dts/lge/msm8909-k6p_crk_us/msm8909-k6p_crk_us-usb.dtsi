/* Copyright (c) 2014, The Linux Foundation. All rights reserved.
 *
 * This program is free software; you can redistribute it and/or modify
 * it under the terms of the GNU General Public License version 2 and
 * only version 2 as published by the Free Software Foundation.
 *
 * This program is distributed in the hope that it will be useful,
 * but WITHOUT ANY WARRANTY; without even the implied warranty of
 * MERCHANTABILITY or FITNESS FOR A PARTICULAR PURPOSE.  See the
 * GNU General Public License for more details.
 */

&usb_otg {
	qcom,phy-vadc = <&pm8916_vadc>;
	qcom,hsusb-otg-mode = <3>;
	qcom,hsusb-otg-otg-control = <2>;
	compatible = "qcom,hsusb-otg";
	usb-id-switch = <&msm_gpio 0 0x00>;
	pinctrl-names = "default";
	pinctrl-0 = <&usbid_en_active>;
	qcom,usbid-gpio = <&msm_gpio 98 0>;
	qcom,hsusb-otg-phy-init-seq = <0x73 0x80 0x38 0x81 0xffffffff>;
	qcom,hsusb-otg-phy-init-host-seq = <0x73 0x80 0x38 0x81 0xffffffff>;
};
