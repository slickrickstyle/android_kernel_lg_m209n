## drivers/video/msm/mdss/Kconfig
```kconfig
config FB_MSM_MDSS_WRITEBACK
	bool "MDSS Writeback Panel"
	---help---
	The MDSS Writeback Panel provides support for routing the output of
	MDSS frame buffer driver and MDP processing to memory.

config FB_MSM_MDSS_HDMI_PANEL
	depends on FB_MSM_MDSS
	bool "MDSS HDMI Tx Panel"
	default n
	---help---
	The MDSS HDMI Panel provides support for transmitting TMDS signals of
	MDSS frame buffer data to connected hdmi compliant TVs, monitors etc.

config FB_MSM_MDSS_HDMI_MHL_SII8334
	depends on FB_MSM_MDSS_HDMI_PANEL
	bool 'MHL SII8334 support '
	default n
	---help---
	  Support the HDMI to MHL conversion.
	  MHL (Mobile High-Definition Link) technology
	  uses USB connector to output HDMI content

config FB_MSM_MDSS_DSI_CTRL_STATUS
	tristate "DSI controller status check feature"
	---help---
	  Check DSI controller status periodically (default period is 5
	  seconds) by sending Bus-Turn-Around (BTA) command. If DSI controller
	  fails to acknowledge the BTA command, it sends PANEL_ALIVE=0 status
	  to HAL layer to reset the controller.

config FB_MSM_MDSS_EDP_PANEL
	depends on FB_MSM_MDSS
	bool "MDSS eDP Panel"
	---help---
	The MDSS eDP Panel provides support for eDP host controller driver
	which runs in Video mode only and is responsible for transmitting
	frame buffer from host SOC to eDP display panel.

config FB_MSM_MDSS_MDP3
	depends on FB_MSM_MDSS
	bool "MDP3 display controller"
	---help---
	The MDP3 provides support for an older version display controller
	included in latest display sub-system, known as MDSS.

config LGE_LCD_ESD
	bool "Enable a function for report panel dead"
	default n

config LGE_LCD_ESD_WITH_QCT_ESD
	depends on LGE_LCD_ESD
	bool "Enable a function for report panel dead with reg read"
	default n
	---help---
	Support esd recovery through 2 way (T-IC interrupt and reg read)

config LGE_LCD_ESD_PANEL_POWER_RECOVERY
	depends on LGE_LCD_ESD
	bool "Support panel power off/on in case report panel dead"
	default n
	---help---
	Support panel power off/on in case report panel dead.
	Some panels need to sustain panel power even LCD off.
	If the panel also need power recovery when esd attack is detected,
	change the status values. Panel driver can check this value during
	panel power sequence.

config CPU_DBI_ILI9341_QVGA_CMD_PANEL
	bool "Enable TIANMA ILI9341 QVGA CMD panel"
	default n
	---help---
	Support TIANMA ILI9488 QVGA CMD panel
	The resolution is (240x320) and 60fps is supported
	Need CPU Interface
	Need 1.8v and 2.8v

config TIANMA_ILI9488_HVGA_CMD_PANEL
	bool "Enable TIANMA ILI9488 HVGA CMD panel"
	default n
	---help---
	Support TIANMA ILI9488 HVGA CMD panel
	The resulotion is (320x480) and 60fps is supported
	Need 1.8v and 2.8v

config TIANMA_ILI9488_HVGA_VIDEO_PANEL
	bool "Enable TIANMA ILI9488 HVGA VIDEO panel"
	default n
	---help---
	Support TIANMA ILI9488 HVGA VIDEO panel
	The resulotion is (320x480) and 60fps is supported
	Need 1.8v and 2.8v

config TIANMA_FT860X_HD_VIDEO_PANEL
	bool "Enable TIANMA FT8607 HD 5INCH VIDEO panel"
	default n
	---help---
	Support TIANMA FT8607 HD 5INCH VIDEO panel
	The resulotion is (1280x720) and 60fps is supported
	Need 1.8v and 3.0v

config JDI_R69326_FWVGA_VIDEO_PANEL
	bool "Enable JDI R69326 FWVGA VIDEO panel"
	default n
	---help---
	Support JDI R69326 FWVGA VIDEO panel
	The resulotion is (854x480) and 60fps is supported
	Need 1.8v and 2.8v

config LGD_SSD2068_FWVGA_VIDEO_PANEL
	bool "Enable LGD SSD2068 FWVGA VIDEO panel"
	default n
	---help---
	Support LGD SSD2068 FWVGA VIDEO panel
	The resulotion is (854x480) and 60fps is supported
	Need 1.8v and 3.0v

config LGD_DB7400_HD_LH530WX2_VIDEO_PANEL
	bool "Enable LGD DB7400 HD LH530WX2 VIDEO panel"
	default n
	---help---
	Support LGD DB7400 HD LH530WX2 VIDEO panel
	The resulotion is (1280x720) and 60fps is supported
	Need 1.8v and 3.0v

config LGD_DB7400_HD_5INCH_VIDEO_PANEL
	bool "Enable LGD DB7400 HD 5INCH VIDEO panel"
	default n
	---help---
	Support LGD DB7400 HD 5INCH VIDEO panel
	The resulotion is (1280x720) and 60fps is supported
	Need 1.8v and 3.0v

config LGD_LG4894_HD_VIDEO_PANEL
	bool "Enable LGD LG4894 HD VIDEO panel"
	default n
	---help---
	Support LGD LG4894 HD VIDEO panel
	The resulotion is (1280x720) and 60fps is supported
	Need 1.8v and 3.0v

config TVS_TD4100_HD_VIDEO_PANEL
	bool "Enable TOVIS TD4100 HD VIDEO panel"
	default n
	---help---
	Support TOVIS TD4100 HD VIDEO panel
	The resulotion is (1280x720) and 60fps is supported
	Need 1.8v

config TCL_ILI9806E_FWVGA_VIDEO_PANEL
	bool "Enable TCL ILI9806E FWVGA VIDEO panel"
	default n
	---help---
	Support TCL ILI9806E FWVGA VIDEO panel
	The resulotion is (854x480) and 60fps is supported
	Need 1.8v and 2.8v

config TCL_ONCELL_ILI9806E_FWVGA_VIDEO_PANEL
	bool "Enable TCL ONCELL ILI9806E FWVGA VIDEO panel"
	default n
	---help---
	Support TCL ONCELL ILI9806E FWVGA VIDEO panel
	The resulotion is (854x480) and 60fps is supported
	Need 1.8v and 2.8v

config LCD_DFPS
	bool "Enable DFPS"
	default n
	---help---
	Support the dynamic change of fps
	Support the read and write operation with sysfs
	The read operation shows the information about bitclk and the current fps

config DSV_CONTROL_API
	bool "Enable DSV control api"
	default n
	---help---
	Support the dsv control api

config LGE_LCD_TUNING
	bool "lcd_gamma_tuning"
	default n
	depends on MACH_LGE
	---help---
	Support LCD gamma tuning
	Support sysfs

config LGE_DISPLAY_POWER_SEQUENCE
	bool "lge panel power sequence"
	default y
	---help---
	Support panel power sequence

config LGE_DISPLAY_TUNING
	bool "Enable panel/mipi/backlight tuning"
	default n
	---help---
	Support LCD initial code, mipi clock, and backlight tuning
	Support sysfs

config LGE_DISPLAY_DFPS
	bool "LG Dynamic LCD Refresh Driver"
	select ARCH_HAS_OPP
	select DEVFREQ_GOV_SIMPLE_ONDEMAND
	default n
	---help---
	This adds the DEVFREQ driver for LG display

config LGE_DISPLAY_VSYNC_SKIP
	bool "MDSS VSYNC Skip scheme"
	default n
	---help---
	This feature provides VSYNC skip scheme.

config LGE_DISPLAY_LCD_OFF_DIMMING
	bool "FOTA BOOT LCD OFF DIMMING"
	default n
	---help---
	This feature provides LCD DIMMING when fota booting mode.

config LGE_DISP_FB_USE_CONTSPLASH
	bool "Keep the reserved cont_splash memory"
	default n
	---help---
	Keep the reserved cont_splash memory to use in crash handler

config LGE_READER_MODE
	depends on FB_MSM_MDSS
	bool "LGE reader mode"
	---help---
	The reader mode provides support to change color temperature
	by sending proper cmds to panel.
```
